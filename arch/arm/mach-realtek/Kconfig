## arch/arm/mach-realtek/Kconfig
```kconfig
# SPDX-License-Identifier: GPL-2.0-or-later
menuconfig ARCH_REALTEK
	bool "Realtek SoCs"
	depends on ARCH_MULTI_V7
	select ARM_GIC
	select ARM_GLOBAL_TIMER
	select CLKSRC_ARM_GLOBAL_TIMER_SCHED_CLOCK
	select GENERIC_IRQ_CHIP
	select RESET_CONTROLLER
	help
	  This enables support for the Realtek SoC family.

if ARCH_REALTEK

config MACH_RTD1195
	bool "Realtek RTD1195 Soc"
	help
	  This enables support for the Realtek RTD1195 SoC family.

config MACH_RTS493X
	bool "Realtek RTS493X Soc"
	select HAVE_ARM_ARCH_TIMER
	select DEBUG_UNCOMPRESS
	help
	  This enables support for the Realtek RTS493X SoC family.

endif
```

## drivers/misc/iomatrix/Kconfig
```kconfig
# SPDX-License-Identifier: GPL-2.0-only
menu "IOMATRIX support"

config RTS490XA_HUB
	tristate "RTS490XA HUB support"
	depends on I2C
	select REGMAP_I2C
	help
	  This enables support for RTS490XA HUB. Say Y here to use RTS490XA HUB driver to
	  configure RTS490XA HUB device.

config MFD_RTS591X_I2C
	tristate "Realtek RTS591x MFD over I2C"
	depends on I2C
	select MFD_CORE
	select REGMAP_IOMATRIX
	select REGMAP_IRQ
	help
	  If you say Y here you get support for RTS591x IC.
	  This driver include only the core APIs. You have to select individual
	  components like PWM or GPIO under the corresponding menus.

endmenu
```

## drivers/net/ethernet/realtek/rtl8168g_8048/Kconfig
```kconfig
# SPDX-License-Identifier: GPL-2.0-only
#
# Realtek device configuration
#

config RTL8168G_8048
	bool "Realtek RTL-8168G_8048 10/100 Mbps Ethernet Adapter support"
	select CRC32
	select NET_CORE
	select MII
	help
	  Support for rtl8168_8048 chipset.

if RTL8168G_8048
config RTL8168_DMA_TEST
	bool "Enable rtl8168 RX driect connect TX for DMA test"

config NUM_RX_DESC
	bool "Set RX DESC NUM"
	default y

if NUM_RX_DESC
choice
	prompt "Selected NUM_RX_DESC"
	default NUM_RX_DESC_1024

config NUM_RX_DESC_1024
	bool "Set rx desc number 1024"

config NUM_RX_DESC_512
	bool "Set rx desc number 512"

config NUM_RX_DESC_256
	bool "Set rx desc number 256"

endchoice
endif

config NUM_TX_DESC
	bool "Set TX DESC NUM"
	default y

if NUM_TX_DESC
choice
	prompt "Selected NUM_TX_DESC"
	default NUM_TX_DESC_1024

config NUM_TX_DESC_1024
	bool "Set tx desc number 1024"

config NUM_TX_DESC_512
	bool "Set tx desc number 512"

config NUM_TX_DESC_256
	bool "Set tx desc number 256"

endchoice
endif

endif
```

## drivers/pinctrl/realtek/Kconfig
```kconfig
# SPDX-License-Identifier: GPL-2.0-only

config PINCTRL_REALTEK_MC
	bool "Realtek MC pin control"
	depends on OF
	select PINMUX
	select PINCONF
	select GPIOLIB
	select GENERIC_PINCONF
	help
	  Say Y here to enable pin controller support for Realtek's
	  management controller SoCs.
```

## drivers/reset/realtek/Kconfig
```kconfig
# SPDX-License-Identifier: GPL-2.0-only

config RESET_REALTEK
	tristate "Realtek Reset Driver"
	help
	  This enable the reset controller driver for Realtek RTS493x Series SoC.
```

## drivers/usb/realtek/Kconfig
```kconfig
config REALTEK_USB_DEVICE
	tristate "Realtek USB Device support"
	depends on USB || USB_GADGET
	help
	  This driver supports Realtek RTS493x Series SoC USB Device driver.
```
