## Documentation/devicetree/bindings/crypto/realtek,rts-crypto.yaml
```yaml
# SPDX-License-Identifier: GPL-2.0
%YAML 1.2
---
$id: http://devicetree.org/schemas/crypto/realtek,rts-crypto.yaml#
$schema: http://devicetree.org/meta-schemas/core.yaml#

title: Realtek Crypto Security System Device Tree Bindings for RTS493xA Series

properties:
  compatible:
    enum:
      - realtek,rts493xa-crypto

  reg:
    maxItems: 1

  interrupts:
    maxItems: 1

  clocks:
    items:
      - description: Crypto Clock

  clock-names:
    items:
      - const: cipher_ck

  resets:
    maxItems: 2

  reset-names:
    items:
      - const: rst
      - const: sd

  aes:
    items:
      - const: ecb
      - const: cbc
      - const: ctr

  aead:
    items:
      - const: gcm(aes)
      - const: ccm(aes)

required:
  - compatible
  - reg
  - interrupts
  - clocks
  - clock-names
  - resets
  - reset-names
  - aes
  - aead

additionalProperties: false

examples:
  - |
    crypto: crypto@18600000 {
      compatible = "realtek,rts493xa-crypto";
      reg = <0x18600000 0x10000>;
      interrupts = <0x0 0x17 0x4>;
      clocks = <&clks 0x41>;
      clock-names = "cipher_ck";
      resets = <&reset 0x4>, <&sysmem 0x4>;
      reset-names = "rst", "sd";
      aes = "ecb", "cbc", "ctr";
      aead = "gcm(aes)", "ccm(aes)";
    };

...
```

## Documentation/devicetree/bindings/crypto/realtek,rts-rsa.yaml
```yaml
# SPDX-License-Identifier: GPL-2.0
%YAML 1.2
---
$id: http://devicetree.org/schemas/crypto/realtek,rts-rsa.yaml#
$schema: http://devicetree.org/meta-schemas/core.yaml#

title: Realtek RSA Device Tree Bindings For rts493xa Series

maintainers:
  - todd_jin <todd_jin@realsil.com.cn>

properties:
  compatible:
    enum:
      - realtek,rts493xa-rsa

  reg:
    maxItems: 1

  interrupts:
    maxItems: 1

  clocks:
    items:
      - description: RSA Clock

  clock-names:
    items:
      - const: rsa_ck

  resets:
    maxItems: 2

  reset-names:
    items:
      - const: rst
      - const: sd

required:
  - compatible
  - reg
  - interrupts
  - clocks
  - clock-names
  - resets
  - reset-names

additionalProperties: false

examples:
  - |
    rsa: rsa@18f00000 {
      compatible = "realtek,rts493xa-rsa";
      reg = <0x18f00000 0x10000>;
      interrupts = <0x0 0x18 0x4>;
      clocks = <&clks 0x4c>;
      clock-names = "rsa_ck";
      resets = <&reset 0x11>, <&sysmem 0xb>;
      reset-names = "rst", "sd";
    };

...
```

## Documentation/devicetree/bindings/crypto/realtek,rts-sha.yaml
```yaml
# SPDX-License-Identifier: GPL-2.0
%YAML 1.2
---
$id: http://devicetree.org/schemas/crypto/realtek,rts-sha.yaml#
$schema: http://devicetree.org/meta-schemas/core.yaml#

title: Realtek SHA Device Tree Bindings For rts493xa Series

maintainers:
  - todd_jin <todd_jin@realsil.com.cn>

properties:
  compatible:
    enum:
      - realtek,rts493xa-sha

  reg:
    maxItems: 1

  interrupts:
    maxItems: 1

  clocks:
    items:
      - description: SHA Clock

  clock-names:
    items:
      - const: sha_ck

  resets:
    maxItems: 1

  reset-names:
    items:
      - const: rst

required:
  - compatible
  - reg
  - interrupts
  - clocks
  - clock-names
  - resets
  - reset-names

additionalProperties: false

examples:
  - |
    sha: sha@19200000 {
      compatible = "realtek,rts493xa-sha";
      reg = <0x19200000 0x10000>;
      interrupts = <0x0 0x19 0x4>;
      clocks = <&clks 0x4d>;
      clock-names = "sha_ck";
      resets = <&reset 0x12>;
      reset-names = "rst";
    };

...
```

## Documentation/devicetree/bindings/dma/realtek,rts-dma.yaml
```yaml
# SPDX-License-Identifier: GPL-2.0
%YAML 1.2
---
$id: http://devicetree.org/schemas/dma/realtek,rts-dma.yaml#
$schema: http://devicetree.org/meta-schemas/core.yaml#

title: Realtek DMA Controller Device Tree Bindings For rts493xa Series

maintainers:
  - todd_jin <todd_jin@realsil.com.cn>

allOf:
  - $ref: "dma-controller.yaml#"

properties:
  compatible:
    contains:
      const: realtek,rts493xa-dmac

  reg:
    maxItems: 1

  interrupts:
    maxItems: 1

  clocks:
    items:
      - description: DMAC Clock

required:
  - compatible
  - reg
  - interrupts
  - clocks

additionalProperties: true

examples:
  - |
    dmahost: dma-controller@18020000 {
      compatible = "realtek,rts493xa-dmac";
      reg = <0x18020000 0x100>;
      interrupts = <0x0 0x16 0x4>;
      clocks = <&clks 0x1b>;
      #dma-cells = <3>;
      dma-channels = <2>;
      dma-vchannels = <4>;
      dma-masters = <1>;
      chan_priority = <1>;
      block_size = <0xfff>;
      data-width = <4 0 0 0>;
    };

...
```

## Documentation/devicetree/bindings/hwmon/realtek,rts-saradc.yaml
```yaml
# SPDX-License-Identifier: GPL-2.0
%YAML 1.2
---
$id: http://devicetree.org/schemas/usb/realtek,rts-saradc.yaml#
$schema: http://devicetree.org/meta-schemas/core.yaml#

title: Realtek SARADC Device Tree Bindings for RTS493xA Series

properties:
  compatible:
    contains:
      const: realtek,rts493xa-saradc

  reg:
    maxItems: 1

required:
  - compatible
  - reg

additionalProperties: true

examples:
  - |
    saradc: saradc@18840000 {
      compatible = "realtek,rts493xa-saradc";
      reg = <0x18840000 0x10000>;
    };

...
```

## Documentation/devicetree/bindings/i2c/realtek,rts-i2c.yaml
```yaml
# SPDX-License-Identifier: GPL-2.0
%YAML 1.2
---
$id: "http://devicetree.org/schemas/i2c/realtek,rts-i2c.yaml#"
$schema: "http://devicetree.org/meta-schemas/core.yaml#"

title: Realtek I2C Controller Device Tree Bindings for RTS493xA Series

allOf:
  - $ref: /schemas/i2c/i2c-controller.yaml#

properties:
  compatible:
    enum:
      - realtek,rts493xa-i2c

  reg:
    maxItems: 1
    description: |
      Base address and size of the I2C controller registers.

  interrupts:
    maxItems: 1
    description: |
      Interrupt specifier for the I2C controller.

  interrupt-parent:
    description: |
      Phandle to the interrupt controller.

  clocks:
    maxItems: 1
    description: |
      Phandle to the clock used by the I2C controller.

  clock-names:
    items:
      - const: i2c_ck
    description: |
      Name of the clock used by the I2C controller.

  resets:
    maxItems: 1
    description: |
      Phandle to the reset controller.

  reset-names:
    items:
      - const: reset-i2c
    description: |
      Name of the reset line used by the I2C controller.

  pinctrl-names:
    items:
      - const: default
    description: |
      Names of the pin control states.

  pinctrl-0:
    description: |
      Phandle to the pin control state.

  "#address-cells":
    const: 1
    description: |
      Number of address cells for child nodes.

  "#size-cells":
    const: 0
    description: |
      Number of size cells for child nodes.

  status:
    enum: [ "okay", "disabled" ]
    description: |
      Operational status of the I2C controller.

required:
  - compatible
  - reg
  - interrupts
  - clocks
  - clock-names
  - resets
  - reset-names
  - pinctrl-names
  - pinctrl-0
  - "#address-cells"
  - "#size-cells"

additionalProperties: true

examples:
  - |
    i2c0: i2c@18880000 {
      compatible = "realtek,rts493xa-i2c";
      reg = <18880000 0x1000>;
      interrupts = <GIC_SPI BSP_IRQ_I2C0 IRQ_TYPE_LEVEL_HIGH>;
      interrupt-parent = <&gic>;
      clocks = <&clks RLX_CLK_I2C0_CK>;
      clock-names = "i2c_ck";
      resets = <&reset FORCE_RESET_I2C0>;
      reset-names = "reset-i2c";
      pinctrl-names = "default";
      pinctrl-0 = <&i2c0_default_mode>;
      #address-cells = <1>;
      #size-cells = <0>;
      status = "disabled";
    };

...
```

## Documentation/devicetree/bindings/ipmi/ssif-bmc.yaml
```yaml
# SPDX-License-Identifier: (GPL-2.0-only OR BSD-2-Clause)
%YAML 1.2
---
$id: http://devicetree.org/schemas/ipmi/ssif-bmc.yaml#
$schema: http://devicetree.org/meta-schemas/core.yaml#

title: SSIF IPMI BMC interface

description: SSIF IPMI BMC device bindings

maintainers:
  - Quan Nguyen <quan@os.amperecomputing.com>

properties:
  compatible:
    enum:
      - ssif-bmc

  reg:
    maxItems: 1

  alert-gpio:
    description: >
      SMBus alert (SMBALERT#) signal associated with the SSIF BMC device.
      Typical active-low. Use GPIO_ACTIVE_LOW if asserted low.
    maxItems: 1

required:
  - compatible
  - reg

additionalProperties: false

examples:
  - |
    i2c {
        #address-cells = <1>;
        #size-cells = <0>;

        ssif-bmc@10 {
            compatible = "ssif-bmc";
            reg = <0x10>;
            alert-gpio = <&pinctrl 58 GPIO_ACTIVE_LOW>;
        };
    };
```

## Documentation/devicetree/bindings/mmc/realtek,rts-mmc.yaml
```yaml
# SPDX-License-Identifier: GPL-2.0
%YAML 1.2
---
$id: http://devicetree.org/schemas/mmc/realtek,rts-mmc.yaml#
$schema: http://devicetree.org/meta-schemas/core.yaml#

title: Realtek MMC Controller Device Tree Bindings for RTS493xA Series

allOf:
  - $ref: "mmc-controller.yaml"

properties:
  compatible:
    contains:
      const: realtek,rts493xa-sdhc

  reg:
    maxItems: 1

  interrupts:
    maxItems: 1

  clocks:
    minItems: 3
    maxItems: 3
    items:
      - description: CRC Clock
      - description: PUSH Clock
      - description: SAMPLE Clock

  clock-names:
    minItems: 3
    maxItems: 3
    items:
      - const: sd_crc_ck
      - const: sd_sample_ck
      - const: sd_push_ck

  resets:
    $ref: '/schemas/types.yaml#/definitions/phandle-array'

  reset-names:
    items:
    - const: reset-sd-device
    - const: sdio-sysmem-up

  pinctrl-names:
    items:
      - const: default
      - const: pullup
      - const: pulldown

required:
  - compatible
  - reg
  - interrupts
  - clocks
  - clock-names
  - resets
  - reset-names
  - pinctrl-names

additionalProperties: true

examples:
  - |
    sdhc0: mmc_sdhc@18300000 {
      compatible = "realtek,rts493xa-sdhc";
      reg = <0x18300000 0x100000>;
      interrupts = <0x0 0x14 0x4>;
      clock-names = "sd_crc_ck", "sd_sample_ck", "sd_push_ck";
      clocks = <&clks 0x64>, <&clks 0x66>, <&clks 0x68>;
      resets = <&reset 0x5>, <&sysmem 0x8>;
      reset-names = "reset-sd-device", "sdio-sysmem-up";
      pinctrl-names = "default", "pullup", "pulldown";
			pinctrl-0 = <&sdhc0_default_mode>;
			pinctrl-1 = <&sdhc0_pullup_mode>;
			pinctrl-2 = <&sdhc0_pulldown_mode>;
      disable-wp;
      cd-inverted;
      bus-width = <4>;
      cap-sd-highspeed;
      cap-mmc-highspeed;
    };

...
```

## Documentation/devicetree/bindings/mtd/realtek,rts-spic.yaml
```yaml
# SPDX-License-Identifier: GPL-2.0
%YAML 1.2
---
$id: http://devicetree.org/schemas/mtd/realtek,rts-spic.yaml#
$schema: http://devicetree.org/meta-schemas/core.yaml#

title: Realtek Flash Controller Device Tree Bindings for RTS493xA Series

properties:
  "#address-cells": true
  "#size-cells": true

  compatible:
    enum:
      - realtek,rts493xa-quadspi

  reg:
    minItems: 1
    maxItems: 2

  clocks:
    items:
      - description: Bus Clock

  clock-names:
    items:
      - const: spi_ck

  interrupts:
    maxItems: 1

  pinctrl-names:
      items:
      - const: default
      - const: quad

  spi-transfer-channel:
    enum:
      - normal
      - fast
      - dual
      - quad
      - dtr
      - qpi

required:
  - compatible
  - reg
  - interrupts
  - clocks
  - clock-names

additionalProperties: true

examples:
  - |
    spi0: spic@18030000 {
      compatible = "realtek,rts493xa-quadspi";
      #address-cells = <1>;
      #size-cells = <0>;
      reg = <0x18030000 0x10000>, <0x18860080 0x28>;
      clocks = <&clks 0x2d>;
      clock-names = "spi_ck";
      spi-deactivate-delay = <0>;
      spi-frequency = <30000000>;
      spi-transfer-channel = "dual";
      interrupts = <0x0 0x20 0x4>;
      pinctrl-names = "default", "quad";
    };
...
```

## Documentation/devicetree/bindings/net/realtek,rts-r8168.yaml
```yaml
# SPDX-License-Identifier: GPL-2.0
%YAML 1.2
---
$id: "http://devicetree.org/schemas/net/realtek,rts-r8168.yaml#"
$schema: "http://devicetree.org/meta-schemas/core.yaml#"

title: Realtek RTL8168 Ethernet Controller Device Tree Bindings for RTS493xA Series

allOf:
  - $ref: /schemas/net/ethernet-controller.yaml#

properties:
  compatible:
    enum:
      - realtek,rts493xa-r8168

  reg:
    minItems: 2
    maxItems: 2
    description: |
      Base addresses and sizes of the Ethernet controller registers.

  interrupt-parent:
    description: |
      Phandle to the interrupt controller.

  interrupts:
    maxItems: 1
    description: |
      Interrupt specifier for the Ethernet controller.

  resets:
    minItems: 3
    maxItems: 3
    description: |
      Phandles to the reset controllers.

  reset-names:
    items:
      - const: eth-reset
      - const: fephy-reset
      - const: eth-mem-up
    description: |
      Names of the reset lines used by the Ethernet controller.

  status:
    enum: [ "okay", "disabled" ]
    description: |
      Operational status of the Ethernet controller.

required:
  - compatible
  - reg
  - interrupts
  - interrupt-parent
  - resets
  - reset-names

additionalProperties: true

examples:
  - |
    eth0: rtl8168@18400000 {
      compatible = "realtek,rts493xa-r8168";
      reg = <0x18400000 0x1000>, <0x18862000 0x1000>;
      interrupt-parent = <&gic>;
      interrupts = <GIC_SPI BSP_IRQ_ETH IRQ_TYPE_LEVEL_HIGH>;
      resets = <&reset FORCE_RESET_ETHERNET>,
               <&reset FORCE_RESET_FEPHY>,
               <&sysmem SYS_MEM_SD_ETH>;
      reset-names = "eth-reset", "fephy-reset", "eth-mem-up";
      status = "disabled";
    };

...
```

## Documentation/devicetree/bindings/pinctrl/realtek,rts-pinctrl.yaml
```yaml
# SPDX-License-Identifier: GPL-2.0
%YAML 1.2
---
$id: http://devicetree.org/schemas/usb/realtek,rts-pinctrl.yaml#
$schema: http://devicetree.org/meta-schemas/core.yaml#

title: Realtek Pin Controller System Device Tree Bindings for RTS493xA Series

properties:
  compatible:
    contains:
      const: realtek,rts493xa-pinctrl

  reg:
    maxItems: 4

  interrupts:
    maxItems: 1

required:
  - compatible
  - reg
  - interrupts

patternProperties:
  '^.*$':
    if:
      type: object
    then:
      patternProperties:
        "^function|groups$":
          allOf:
            - $ref: "/schemas/types.yaml#/definitions/string"

additionalProperties: true

examples:
  - |
    pinctrl: pinctrl@18800000 {
      #address-cells = <1>;
      #size-cells = <1>;
      ranges;
      compatible = "realtek,rts493xa-pinctrl";
      reg = <0x18800000 0x10000 0x18300000 0x100000
				0x18700000 0x100000 0x185000d4 0x4>;
      interrupts = <GIC_SPI BSP_IRQ_GPIO IRQ_TYPE_LEVEL_HIGH>;
      interrupt-parent = <&gic>;
      pwm-etnled-mapping = /bits/ 32 <0 1 2 0>;
      gpio-controller;
      #gpio-cells = <2>;
      ngpios = <89>;
      status = "disabled";

      i2c0_default_mode: i2c0_default {
        default_mux {
          function = "i2cfunc";
          groups = "i2c0grp";
        };
      };
    };
...
```

## Documentation/devicetree/bindings/pwm/realtek,rts-pwm.yaml
```yaml
# SPDX-License-Identifier: GPL-2.0
%YAML 1.2
---
$id: http://devicetree.org/schemas/pwm/realtek,rts-pwm.yaml#
$schema: http://devicetree.org/meta-schemas/core.yaml#

title: Realtek PWM Device Tree Bindings for RTS493xA Series

properties:
  compatible:
    contains:
      const: realtek,rts493xa-pwm

  reg:
    maxItems: 1

  pinctrl-names:
    enum:
    - default

required:
  - compatible
  - reg
  - pinctrl-names

additionalProperties: true

examples:
  - |
    pwm: pwm@18820000 {
      compatible = "realtek,rts493xa-pwm";
      reg = <0x18820000 0x10000>;
      pinctrl-names = "default";
    };

...
```
