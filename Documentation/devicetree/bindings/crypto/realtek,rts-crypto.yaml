## Documentation/devicetree/bindings/reset/realtek,rts-reset.yaml
```yaml
# SPDX-License-Identifier: GPL-2.0
%YAML 1.2
---
$id: http://devicetree.org/schemas/reset/realtek,rts-reset.yaml#
$schema: http://devicetree.org/meta-schemas/core.yaml#

title: Realtek Reset Controller Device Tree Bindings for RTS493xA Series

properties:
  compatible:
    contains:
      const: realtek,rts493xa-reset

  reg:
    maxItems: 1

  "#reset-cells":
    const: 1

required:
  - compatible
  - reg
  - "#reset-cells"

additionalProperties: true

examples:
  - |
    reset: reset-controller@188d8000 {
      compatible = "realtek,rts493xa-reset";
      reg = <0x188d8000 0x1000>;
      #reset-cells = <1>;
    };

...
```

## Documentation/devicetree/bindings/rng/realtek,rts-trng.yaml
```yaml
# SPDX-License-Identifier: GPL-2.0
%YAML 1.2
---
$id: http://devicetree.org/schemas/rng/realtek,rts-trng.yaml#
$schema: http://devicetree.org/meta-schemas/core.yaml#

title: Realtek TRNG Device Tree Bindings for RTS493xA Series

properties:
  compatible:
    enum:
      - realtek,rts493xa-trng

  reg:
    maxItems: 1

  interrupts:
    maxItems: 1

  clocks:
    items:
      - description: TRNG Clock

  clock-names:
    items:
      - const: trng_ck

  resets:
    maxItems: 1

  reset-names:
    items:
      - const: rst

required:
  - compatible
  - reg
  - interrupts
  - clocks
  - clock-names
  - resets
  - reset-names

additionalProperties: false

examples:
  - |
    trng: trng@188a0100 {
      compatible = "realtek,rts493xa-trng";
      reg = <0x188a0100 0x100>;
      interrupts = <0x0 0x1a 0x4>;
      clocks = <&clks 0x56>;
      clock-names = "trng_ck";
      resets = <&reset 0x13>;
      reset-names = "rst";
    };

...
```

## Documentation/devicetree/bindings/rtc/realtek,rts-rtc.yaml
```yaml
# SPDX-License-Identifier: GPL-2.0
%YAML 1.2
---
$id: http://devicetree.org/schemas/rtc/realtek,rts-rtc.yaml#
$schema: http://devicetree.org/meta-schemas/core.yaml#

title: Realtek RTC Device Tree Bindings for RTS493xA Series

allOf:
  - $ref: "rtc.yaml#"

properties:
  compatible:
    contains:
      const: realtek,rts493xa-rtc

  reg:
    maxItems: 1

  interrupts:
    maxItems: 1

required:
  - compatible
  - reg
  - interrupts

additionalProperties: true

examples:
  - |
    rtc: rtc@18850000 {
        compatible = "realtek,rts493xa-rtc";
        reg = <0x18850000 0x1000>;
        interrupts = <0x0 0x2a 0x4>;
    };

...
```

## Documentation/devicetree/bindings/serial/realtek,rts-uart.yaml
```yaml
# SPDX-License-Identifier: GPL-2.0
%YAML 1.2
---
$id: http://devicetree.org/schemas/serial/realtek,rts-uart.yaml#
$schema: http://devicetree.org/meta-schemas/core.yaml#

title: Realtek UART Device Tree Bindings for RTS493xA Series

allOf:
  - $ref: /schemas/serial.yaml#

properties:
  compatible:
    contains:
      const: realtek,rts493xa-uart

  reg:
    maxItems: 1

  interrupts:
    maxItems: 1

  reg-shift:
    default: 2

  reg-io-width:
    default: 4

  current-speed:
    default: 57600

  clocks:
    maxItems: 1

  clock-frequency:
    default: 24000000

  pinctrl-names:
    items:
      - const: default

required:
  - compatible
  - reg
  - interrupts
  - reg-shift
  - reg-io-width
  - current-speed
  - clocks
  - clock-frequency
  - pinctrl-names

additionalProperties: true

examples:
  - |
    uart0: serial@18810000 {
      compatible = "realtek,rts493xa-uart";
      reg = <0x18810000 0x100>;
      interrupts = <0x0 0x25 0x4>;
      reg-shift = <2>;
      reg-io-width = <4>;
      current-speed = <57600>;
      clocks = <&clks RLX_CLK_UART_CK>;
      clock-frequency = <24000000>;
      pinctrl-names = "default";
      pinctrl-0 = <&uart0_default_mode>;
    };

...
```

## Documentation/devicetree/bindings/spi/realtek,rts-ssi.yaml
```yaml
# SPDX-License-Identifier: GPL-2.0
%YAML 1.2
---
$id: http://devicetree.org/schemas/spi/realtek,rts-ssi.yaml#
$schema: http://devicetree.org/meta-schemas/core.yaml#

title: Realtek Synchronous Serial Interface Device Tree Bindings for RTS493xA Series

allOf:
  - $ref: spi-controller.yaml#

properties:
  compatible:
    enum:
      - realtek,dw-apb-ssi

  reg:
    minItems: 2
    maxItems: 2
    description: |
      Base addresses and sizes of the SPI controller registers.

  clocks:
    minItems: 1
    description: |
      Phandle to the clock used by the SPI controller.

  clock-names:
    items:
      - const: ssi_ck
    description: |
      Name of the clock used by the SPI controller.

  interrupt-parent:
    description: |
      Phandle to the interrupt controller.

  interrupts:
    maxItems: 1
    description: |
      Interrupt specifier for the SPI controller.

  num-cs:
    minimum: 1
    maximum: 4
    description: |
      Number of chip selects.

  "#address-cells":
    const: 1
    description: |
      Number of address cells for child nodes.

  "#size-cells":
    const: 0
    description: |
      Number of size cells for child nodes.

  pinctrl-names:
    items:
      - const: default
    description: |
      Names of the pin control states.

  pinctrl-0:
    description: |
      Phandle to the pin control state.

  status:
    enum: [ "okay", "disabled" ]
    description: |
      Operational status of the SPI controller.

required:
  - compatible
  - reg
  - clocks
  - clock-names
  - interrupts
  - num-cs
  - "#address-cells"
  - "#size-cells"

additionalProperties: true

examples:
  - |
    spi1: spi@19210000 {
      compatible = "realtek,dw-apb-ssi";
      reg = <0x19210000 0x10000>, <0x18870070 0x20>;
      clocks = <&clks RLX_CLK_SSI_CK>;
      clock-names = "ssi_ck";
      interrupt-parent = <&gic>;
      interrupts = <GIC_SPI BSP_IRQ_SSI IRQ_TYPE_LEVEL_HIGH>;
      num-cs = <2>;
      #address-cells = <1>;
      #size-cells = <0>;
      pinctrl-names = "default";
      pinctrl-0 = <&ssi_default_mode>;
      status = "disabled";
    };

...
```

## Documentation/devicetree/bindings/thermal/realtek,rts-thermal.yaml
```yaml
# SPDX-License-Identifier: GPL-2.0
%YAML 1.2
---
$id: http://devicetree.org/schemas/usb/realtek,rts-thermal.yaml#
$schema: http://devicetree.org/meta-schemas/core.yaml#

title: Realtek Thermal Device Tree Bindings for RTS493xA Series

properties:
  compatible:
    contains:
      const: realtek,rts493xa-thermal

  reg:
    maxItems: 1

  interrupts:
    maxItems: 1

  "#thermal-sensor-cells":
    const: 0

required:
  - compatible
  - reg
  - interrupts
  - "#thermal-sensor-cells"

additionalProperties: true

examples:
  - |
    thermal: thermal@188a0200 {
      compatible = "realtek,rts493xa-thermal";
      reg = <0x188a0200 0x100>;
      interrupts = <0x0 0x29 0x4>;
      #thermal-sensor-cells = <0>;
    };

...
```

## Documentation/devicetree/bindings/timer/realtek,rts-xb2timer.yaml
```yaml
# SPDX-License-Identifier: GPL-2.0
%YAML 1.2
---
$id: http://devicetree.org/schemas/usb/realtek,rts-xb2timer.yaml#
$schema: http://devicetree.org/meta-schemas/core.yaml#

title: Realtek XB2 Timer Device Tree Bindings for RTS493xA Series

properties:
  compatible:
    contains:
      const: realtek,rts493xa-timer

  reg:
    maxItems: 1

  interrupts:
    maxItems: 1

required:
  - compatible
  - reg
  - interrupts

additionalProperties: true

examples:
  - |
    rts_timer0: rts_timer@18890000 {
      compatible = "realtek,rts493xa-timer";
      reg = <0x18890000 0x100>;
      interrupts = <0x0 0x0 0x4>;
    };

...
```

## Documentation/devicetree/bindings/usb/realtek,rts-ehci.yaml
```yaml
# SPDX-License-Identifier: GPL-2.0
%YAML 1.2
---
$id: http://devicetree.org/schemas/usb/realtek,rts-ehci.yaml#
$schema: http://devicetree.org/meta-schemas/core.yaml#

title: Realtek USB EHCI Controller Device Tree Bindings for RTS493xA Series

allOf:
  - $ref: "usb-hcd.yaml"

properties:
  compatible:
    contains:
      const: realtek,rts493xa-ehci

  reg:
    maxItems: 1

  interrupts:
    maxItems: 1

  resets:
    $ref: '/schemas/types.yaml#/definitions/phandle-array'

  reset-names:
    const: reset-usb-host

required:
  - compatible
  - reg
  - interrupts
  - resets
  - reset-names

additionalProperties: false

examples:
  - |
    usb_ehci: usb_ehci@18100000 {
      compatible = "realtek,rts493xa-ehci";
      reg = <0x18100000 0x1000>;
      interrupts = <0x0 0x10 0x4>;
      resets = <&reset 0xb>;
      reset-names = "reset-usb-host";
    };

...
```

## Documentation/devicetree/bindings/usb/realtek,rts-ohci.yaml
```yaml
# SPDX-License-Identifier: GPL-2.0
%YAML 1.2
---
$id: http://devicetree.org/schemas/usb/realtek,rts-ohci.yaml#
$schema: http://devicetree.org/meta-schemas/core.yaml#

title: Realtek USB OHCI Controller Device Tree Bindings for RTS493xA Series

allOf:
  - $ref: "usb-hcd.yaml"

properties:
  compatible:
    contains:
      const: realtek,rts493xa-ohci

  reg:
    maxItems: 1

  interrupts:
    maxItems: 1

  resets:
    $ref: '/schemas/types.yaml#/definitions/phandle-array'

  reset-names:
    const: reset-usb-host

required:
  - compatible
  - reg
  - interrupts
  - reset-names

additionalProperties: false

examples:
  - |
    usb_ohci: usb_ohci@18180000 {
      compatible = "realtek,rts493xa-ohci";
      reg = <0x18180000 0x1000>;
      interrupts = <0x0 0x11 0x4>;
      resets = <&reset 0xb>;
      reset-names = "reset-usb-host";
    };

...
```

## Documentation/devicetree/bindings/usb/realtek,rts-usb-device.yaml
```yaml
# SPDX-License-Identifier: GPL-2.0
%YAML 1.2
---
$id: http://devicetree.org/schemas/usb/realtek,rts-usb-device.yaml#
$schema: http://devicetree.org/meta-schemas/core.yaml#

title: Realtek USB Dev Device Tree Bindings for RTS493xA Series

allOf:
  - $ref: "usb-hcd.yaml"

properties:
  compatible:
    contains:
      const: realtek,rts493xa-usb-device

  reg:
    minItems: 1
    maxItems: 2

  interrupts:
    maxItems: 2

  resets:
    $ref: '/schemas/types.yaml#/definitions/phandle-array'

  reset-names:
    items:
    - const: reset-usb-device
    - const: u2dev-sysmem-up

required:
  - compatible
  - reg
  - interrupts
  - resets
  - reset-names

additionalProperties: false

examples:
  - |
    usb_device: usb_device@18290000 {
      compatible = "realtek,rts493xa-usb-device";
      reg = <0x18290000 0x900>, <0x18280000 0x2000>;
      interrupts =	<0x0 0x12 0x4>, <0x0 0x13 0x4>;
      resets = <&reset 0xa>, <&sysmem 0x7>;
      reset-names = "reset-usb-device", "u2dev-sysmem-up";
    };

...
```

## Documentation/devicetree/bindings/usb/realtek,rts-usb-phy.yaml
```yaml
# SPDX-License-Identifier: GPL-2.0
%YAML 1.2
---
$id: http://devicetree.org/schemas/usb/realtek,rts-usb-phy.yaml#
$schema: http://devicetree.org/meta-schemas/core.yaml#

title: Realtek USB Phy Device Tree Bindings for RTS493xA Series

allOf:
  - $ref: "usb-hcd.yaml"

properties:
  compatible:
    contains:
      const: realtek,rts493xa-usbphy

  reg:
    maxItems: 1

  interrupts:
    maxItems: 1

  pinctrl-names:
    enum:
      - init
      - sleep

required:
  - compatible
  - reg
  - interrupts
  - pinctrl-names

additionalProperties: false

examples:
  - |
    usb_phy: usb_phy@18140000 {
      compatible = "realtek,rts493xa-usbphy";
      reg = <0x18140000 0x1000>;
      interrupts =	<0x0 0x13 0x4>;
      pinctrl-names = "init","sleep";
      pinctrl-0 = <&usbd_init_mode>;
      pinctrl-1 = <&usbd_default_mode>;
      host-sens-obj = <7>;
    };

...
```

## Documentation/devicetree/bindings/watchdog/realtek,rts-wdt.yaml
```yaml
# SPDX-License-Identifier: GPL-2.0
%YAML 1.2
---
$id: http://devicetree.org/schemas/watchdog/realtek,rts-wdt.yaml#
$schema: http://devicetree.org/meta-schemas/core.yaml#

title: Realtek Watchdog Device Tree Bindings for RTS493xA Series

allOf:
  - $ref: "watchdog.yaml#"

properties:
  compatible:
    contains:
      const: realtek,rts493xa-wdt

  reg:
    maxItems: 1

required:
  - compatible
  - reg

additionalProperties: true

examples:
  - |
    watchdog: watchdog@188da000 {
      compatible = "realtek,rts493xa-wdt";
      reg = <0x188da000 0x10000>;
    };

...
```
